/********************************************************************************************************************************************
*                                                                                                                                           *
*              ---------------------------------以下是模块的修改记录区-----------------------------------------                             *
*                                                                                                                                           *
********************************************************************************************************************************************/
/**********************************************
 * 内容：
 * 日期：2022-06-02
 * 作者：YJX
 * 版本号：V1.0（初版）
 ***********************************************
 * 修改内容：
 * 修改日期：
 * 修改作者：
 * 版本号：
 ***********************************************
*/
/********************************************************************************************************************************************
*                                                                                                                                           *
*               ----------------------------------以下模块的说明区-----------------------------------------                                  *
*                                                                                                                                           *
********************************************************************************************************************************************/
/*	

*/
#include "DRI_GPIO.h"
/********************************************************************************************************************************************
*                                                                                                                                           *
*               ----------------------------------以下模块的对接函数区-----------------------------------------                                  *
*                                                                                                                                           *
********************************************************************************************************************************************/

/********************************************************************************************************************************************
*                                                                                                                                           *
*               ----------------------------------以下是模块的变量申明和宏定义区--------------------------------                      *
*                                                                                                                                           *
********************************************************************************************************************************************/
#define GPIO_PERIPH(PortN)    (GPIOA + (PortN * 0x00000400U))
#define GPIO_PIN(PinN)        BIT(PinN)
/********************************************************************************************************************************************
*                                                                                                                                           *
*               ----------------------------------以下是模块的内部函数申明区------------------------------------                          *
*                                                                                                                                           *
********************************************************************************************************************************************/


/********************************************************************************************************************************************
*                                                                                                                                           *
*               ----------------------------------以下是模块的系统函数代码区------------------------------------                          *
*                                                                                                                                           *
********************************************************************************************************************************************/


/********************************************************************************************************************************************
*                                                                                                                                           *
*               ----------------------------------以下是模块的用户函数代码区------------------------------------                          *
*                                                                                                                                           *
********************************************************************************************************************************************/
/***************************************************************************
* 函 数 名: DRI_GPIO_Config
* 功能描述：GPIO引脚配置函数
* 入口参数：
            PortNum enPort：端口号(取GPORTA,GPORTB,GPORTC)
            PinNum u16Pin：引脚号(取GP00~GP15)
            PinMode gm：GDOut表示数字输出 GDIn表示数字输入
* 出口参数：
            -1:表示配置失败
            0:表示配置成功
* 注意事项:  
            无
* 例     如:
* 修改记录 :
*           2025-08-29 BY:YJX
***************************************************************************/
s8 DRI_GPIO_Config(PortNum portn, PinNum pinn, PinMode gm)
{
     switch(portn)
     {
          case GPORTA:
               rcu_periph_clock_enable(RCU_GPIOA);
               break;
          case GPORTB:
               rcu_periph_clock_enable(RCU_GPIOB);
               break;
          case GPORTC:
               rcu_periph_clock_enable(RCU_GPIOC);
               break;
          default:
               return -1;
     }

     switch(gm)
     {
          case GDOut://数字输出
               gpio_init(GPIO_PERIPH(portn), GPIO_MODE_OUT_PP, GPIO_OSPEED_50MHZ, GPIO_PIN(pinn));
               break;
          case GDIn://数字输入
               gpio_init(GPIO_PERIPH(portn), GPIO_MODE_IN_FLOATING, GPIO_OSPEED_50MHZ, GPIO_PIN(pinn));
               break;
          default:
               return -2;
     }     
     return 0;
}

/***************************************************************************
* 函 数 名: DRI_GPIO_OUT_1
* 功能描述：GPIO引脚输出高电平函数
* 入口参数：
            PortNum portn：端口号(取GPORTA,GPORTB,GPORTC,GPORTD,GPORTE,GPORTH)
            PinNum pinn：引脚号(取GP00~GP15)
* 出口参数：
            无
* 注意事项:  
            无
* 例     如:
* 修改记录 :
*           2025-08-29 BY:YJX
***************************************************************************/
void DRI_GPIO_OUT_1(PortNum portn, PinNum pinn)
{
     //gpio_bit_set(GPIO_PERIPH(portn), GPIO_PIN(pinn));
     GPIO_BOP(GPIO_PERIPH(portn)) = GPIO_PIN(pinn);
}

/***************************************************************************
* 函 数 名: DRI_GPIO_OUT_0
* 功能描述：GPIO引脚输出低电平函数
* 入口参数：
            PortNum enPort：端口号(取GPORTA,GPORTB,GPORTC,GPORTD,GPORTE,GPORTH)
            PinNum u16Pin：引脚号(取GP00~GP15)
* 出口参数：
            无
* 注意事项:  
            无
* 例     如:
* 修改记录 :
*           2025-08-29 BY:YJX
***************************************************************************/
void DRI_GPIO_OUT_0(PortNum portn, PinNum pinn)
{
     GPIO_BC(GPIO_PERIPH(portn)) = GPIO_PIN(pinn);
}

/***************************************************************************
* 函 数 名: DRI_GPIO_OUT_Turn
* 功能描述：GPIO引脚输出翻转函数
* 入口参数：
            PortNum enPort：端口号(取GPORTA,GPORTB,GPORTC,GPORTD,GPORTE,GPORTH)
            PinNum u16Pin：引脚号(取GP00~GP15)
* 出口参数：
            无
* 注意事项:  
            无
* 例     如:
* 修改记录 :
*           2025-08-29 BY:YJX
***************************************************************************/
void DRI_GPIO_OUT_Turn(PortNum portn, PinNum pinn)
{
     if((u32)RESET != (GPIO_ISTAT(GPIO_PERIPH(portn)) & (GPIO_PIN(pinn))))
     {
          GPIO_BC(GPIO_PERIPH(portn)) = GPIO_PIN(pinn);
     }
     else
     {
          GPIO_BOP(GPIO_PERIPH(portn)) = GPIO_PIN(pinn);
     }
}

/***************************************************************************
* 函 数 名: DRI_GPIO_Read
* 功能描述：GPIO引脚读函数
* 入口参数：
            PortNum enPort：端口号(取GPORTA,GPORTB,GPORTC,GPORTD,GPORTE,GPORTH)
            PinNum u16Pin：引脚号(取GP00~GP15)
* 出口参数：
            0:表示低电平
          非0:表示高电平
* 注意事项:  
            无
* 例     如:
* 修改记录 :
*           2025-08-29 BY:YJX
***************************************************************************/
u8 DRI_GPIO_Read(PortNum portn, PinNum pinn)
{
     if((u32)RESET != (GPIO_ISTAT(GPIO_PERIPH(portn)) & (GPIO_PIN(pinn))))
     {
          return 1; 
     }
     return 0;
}


/********************************************************************************************************************************************
*                                                                                                                                           *
*               ----------------------------------以下是模块的内部函数代码区------------------------------------                          *
*                                                                                                                                           *
********************************************************************************************************************************************/





