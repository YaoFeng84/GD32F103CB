/********************************************************************************************************************************************
*                                                                                                                                           *
*              ---------------------------------以下是模块的修改记录区-----------------------------------------                             *
*                                                                                                                                           *
********************************************************************************************************************************************/
/**********************************************
 * 内容：
 * 日期：2025-08-29
 * 作者：YJX
 * 版本号：V1.0（初版）
 ***********************************************
 * 修改内容：
 * 修改日期：
 * 修改作者：
 * 版本号：
 ***********************************************
*/
/********************************************************************************************************************************************
*                                                                                                                                           *
*               ----------------------------------以下模块的说明区-----------------------------------------                                  *
*                                                                                                                                           *
********************************************************************************************************************************************/
/*	
特点：
     【1】、当HCLK=200MHz时，最大定时到680ms
     【2】、

*/
#include "DRI_Systick.h"
#include "DRI_CLK.h"
/********************************************************************************************************************************************
*                                                                                                                                           *
*               ----------------------------------以下模块的对接函数区-----------------------------------------                                  *
*                                                                                                                                           *
********************************************************************************************************************************************/

/********************************************************************************************************************************************
*                                                                                                                                           *
*               ----------------------------------以下是模块的变量申明和宏定义区--------------------------------                      *
*                                                                                                                                           *
********************************************************************************************************************************************/
#define SysTickClkSourceAutoSwitch 1//自动切换优先使用HCLK，如果时间不够，则使用HCLK/8(0表示配置时不自动切换 1表示配置时自动切换)

static void (*SystickCallBackFunP)(void) = NULLFP;//Systick中断回调函数
/********************************************************************************************************************************************
*                                                                                                                                           *
*               ----------------------------------以下是模块的内部函数申明区------------------------------------                          *
*                                                                                                                                           *
********************************************************************************************************************************************/
static s8 SysTick_CalaReload(u32 msn,u32 *rldp);

/********************************************************************************************************************************************
*                                                                                                                                           *
*               ----------------------------------以下是模块的系统函数代码区------------------------------------                          *
*                                                                                                                                           *
********************************************************************************************************************************************/
/***************************************************************************
* 函 数 名: DRI_Systick_Config
* 功能描述：Systick配置函数
* 入口参数：
            u32 msn:定时毫秒数
            u8 priority:优先级(0~15)
            void (*cbfp)(void):中断回调函数指针
* 出口参数：
            -1:表示配置失败
            0:表示配置成功
* 注意事项:  
            配置成功后，Systick就启动
* 例     如:
* 修改记录:
*           2025-08-29 BY:YJX
***************************************************************************/
s8 DRI_SysTick_Config(u32 msn,u8 priority,void (*cbfp)(void))
{
     u32 reloadv;
     s8 clks = 0;//驱动时钟源选择 0:HCLK驱动 1:HCLK/8驱动
     
     if(priority > 15)
     {
          return -1;
     }

     clks = SysTick_CalaReload(msn,&reloadv);
     if(clks < 0)
     {
          return -2;
     }

     SysTick->CTRL &= ~SysTick_CTRL_ENABLE_Msk;//关闭Systick
     
     SCB->ICSR |= SCB_ICSR_PENDSTCLR_Msk;//清除SysTick中断标志
     SCB->SHCSR &= ~SCB_SHCSR_SYSTICKACT_Msk;//退出SysTick中断
     SysTick->LOAD  = reloadv;//重载值设置
     SysTick->VAL   = 0;      //对当前值寄存器进行清零(对这个寄存器清零的同时会对CTRL寄存器的COUNTFLAG这个中断标志清零)
     NVIC_SetPriority (SysTick_IRQn, priority);//优先级
     SystickCallBackFunP = cbfp;
     if(clks)
     {
          SysTick->CTRL  = 0xFFFFFFFB; //使用HCLK/8作为时钟源，使能SysTick中断，开启定时器
     }
     else
     {
          SysTick->CTRL  = 0xFFFFFFFF; //使用HCLK做为时钟源，使能SysTick中断，开启定时器
     }
     
     return 0;  
}

/***************************************************************************
* 函 数 名: SysTick_Handler
* 功能描述：Systick中断入口函数
* 入口参数：
            无
* 出口参数：
            无
* 注意事项:  
            无
* 例     如:
* 修改记录:
*           2025-08-29 BY:YJX
***************************************************************************/
void SysTick_Handler(void)
{
     SystickCallBackFunP();
}
/********************************************************************************************************************************************
*                                                                                                                                           *
*               ----------------------------------以下是模块的用户函数代码区------------------------------------                          *
*                                                                                                                                           *
********************************************************************************************************************************************/
/*-------------------------------------------------
函数名:DRI_SysTick_INT_DISABLE
功  能:禁止systick模块中断函数
参  数:
       无
返回值:
       无
注  意:
       无
示  例:

版  本:V1.0
时  间:2025-08-29 BY:YJX
-------------------------------------------------*/
void DRI_SysTick_INT_DISABLE(void)
{
     //关闭嘀嗒时钟中断
     SysTick->CTRL &= ~(SysTick_CTRL_TICKINT_Msk);
}

/*-------------------------------------------------
函数名:DRI_SysTick_Disable
功  能:禁止systick模块函数
参  数:
       无
返回值:
       无
注  意:
       无
示  例:

版  本:V1.0
时  间:2025-08-29 BY:YJX
-------------------------------------------------*/
void DRI_SysTick_Disable(void)
{
    SysTick->CTRL &= ~SysTick_CTRL_ENABLE_Msk;
}


/*-------------------------------------------------
函数名:DRI_SysTick_INTFLAG_CLR
功  能:清除systick模块中断标志函数
参  数:
       无
返回值:
       无
注  意:
       无
示  例:

版  本:V1.0
时  间:2025-08-29 BY:YJX
-------------------------------------------------*/
void DRI_SysTick_INTFLAG_CLR(void)
{
     SCB->ICSR |= SCB_ICSR_PENDSTCLR_Msk;//清除SysTick中断标志
}

/*-------------------------------------------------
函数名:DRI_SysTick_INT_EXIT
功  能:退出systick模块中断函数
       如果当前在systick中断中处理，可以利用此函数来退出中断
参  数:
       无
返回值:
       无
注  意:
       无
示  例:

版  本:V1.0
时  间:2025-08-29 BY:YJX
-------------------------------------------------*/
void DRI_SysTick_INT_EXIT(void)
{
     SCB->ICSR |= SCB_ICSR_PENDSTCLR_Msk;//清除SysTick中断标志
     SCB->SHCSR &= ~SCB_SHCSR_SYSTICKACT_Msk;//退出SysTick中断
}

/********************************************************************************************************************************************
*                                                                                                                                           *
*               ----------------------------------以下是模块的内部函数代码区------------------------------------                          *
*                                                                                                                                           *
********************************************************************************************************************************************/
//计算重载值
//u32 msn:定时毫秒
//u32 *rldp:重载值存放空间指针
//返回值:
//小于0：出错
//1:使用HCLK/8驱动 0:使用HCLK驱动
static s8 SysTick_CalaReload(u32 msn,u32 *rldp)
{
     s8 result = 0;
     u32 u32temp;
     ClkFreqValue fv;
     float Fdtv_us;//驱动时钟周期，单位us
     float Ftemp;
          
     DRI_CLK_GetClockFreq(&fv);//获取HCLK频率，单位HZ
     Fdtv_us = (1000000.0 / fv.hclkFreq);//此处使用us是担心，如果使用了ms，而频率过高，导致小数位数超过7位

     if(msn > ((Fdtv_us * (SysTick_LOAD_RELOAD_Msk + 1)) / 1000.0f))
     {//msn大于定时器的最大毫秒数
          if(SysTickClkSourceAutoSwitch)
          {//驱动频率自动切换
               result = 1;
               Fdtv_us = 8*(1000000.0 / fv.hclkFreq);//使用HCLK/8做为驱动时钟
               if(msn > ((Fdtv_us * (SysTick_LOAD_RELOAD_Msk + 1)) / 1000.0f))
               {//大于定时器的最大毫秒数
                    return -1;
               }
          }
          else
          {//不自动切换
               return -1;
          }
     }

     Ftemp = ((msn * 1000.0) / Fdtv_us);
     u32temp = (u32)Ftemp;//
     if((Ftemp - u32temp) > 0.5f)
     {//四舍五入
          u32temp++;
     }
     u32temp--;
     *rldp = u32temp;
     
     return result;
}


